## app/boards/eurus_nexus_v1_1/Kconfig.eurus_nexus_v1_1
```kconfig
# Copyright (c) 2025 The efc developers
# GNU General Public License

config BOARD_EURUS_NEXUS_V1_1
    select SOC_STM32H562XE
```

## boards/eurus_project/eurus_nexus_v1_1/Kconfig.eurus_nexus_v1_1
```kconfig
# Copyright (c) 2025 The efc developers
# GNU General Public License

config BOARD_EURUS_NEXUS_V1_1
    bool "eurus_nexus_v1_1 board"
    default y
    select SOC_STM32H562XX
```

## boards/eurus_project/eurus_nexus_v1_1/board.yml
```yaml
board:
  name: eurus_nexus_v1_1
  full_name: Eurus Nexus Version 1.1
  vendor: eurus_project
  socs:
    - name: stm32h562xx
```

## boards/eurus_project/eurus_nexus_v1_1/eurus_nexus_v1_1_defconfig
```kconfig
# 
# This file is part of the efc project <https://github.com/eurus-project/efc/>.
# Copyright (c) 2024 The efc developers.
# 
# This program is free software: you can redistribute it and/or modify
# it under the terms of the GNU General Public License as published by
# the Free Software Foundation, version 3.
# 
# This program is distributed in the hope that it will be useful, but
# WITHOUT ANY WARRANTY; without even the implied warranty of
# MERCHANTABILITY or FITNESS FOR A PARTICULAR PURPOSE. See the GNU
# General Public License for more details.
# 
# You should have received a copy of the GNU General Public License
# along with this program. If not, see <http://www.gnu.org/licenses/>.
#

CONFIG_GPIO=y
CONFIG_SERIAL=y
CONFIG_CONSOLE=y
CONFIG_USB_DEVICE_STACK=y
CONFIG_I2C=y
CONFIG_SPI=y
```

## boards/generic/stm32f103_bluepill/Kconfig.defconfig
```kconfig
# Always set CONFIG_BOARD here. This isn't meant to be customized,
# but is set as a "default" due to Kconfig language restrictions.
config BOARD
    default "generic_stm32f103_bluepill"
    depends on BOARD_GENERIC_STM32F103_BLUEPILL
```

## boards/generic/stm32f103_bluepill/board.yml
```yaml
board:
  name: generic_stm32f103_bluepill
  vendor: generic
  socs:
    - name: stm32f103xb
```

## demos/bmp280/Kconfig
```kconfig
# BMP280 demo configuration

mainmenu "Eurus Flight Controller - BMP280 demo"


source "Kconfig.zephyr"
```

## demos/mpu6050/Kconfig
```kconfig
# MPU6050 demo configuration

mainmenu "Eurus Flight Controller - MPU6050 demo"


source "Kconfig.zephyr"
```

## libs/motor_control/esc/Kconfig
```kconfig
# ESC (Electronic Speed Controller) library configuration options

menuconfig ESC
    bool "Electronic Speed Controller (ESC) library"
    help 
        Enable support for the ESC library.

if ESC

# Manual minimum pulse offset of ESC signal
config ESC_MANUAL_MIN_PULSE_OFFSET
    bool "Enable manual minimum thrust offset for ESC"

config ESC_MIN_PULSE_OFFSET_PERCENT
    int "Duty cycle offset in percentage"
    default 30
    depends on ESC_MANUAL_MIN_PULSE_OFFSET

# Manual maximum pulse offset of ESC signal
config ESC_MANUAL_MAX_PULSE_OFFSET
    bool "Enable manual maximum thrust offset for ESC"

config ESC_MAX_PULSE_OFFSET_PERCENT
    int "Duty cycle offset in percentage"
    default 0
    depends on ESC_MANUAL_MAX_PULSE_OFFSET


endif # ESC
```
